## machine/meta-xt-images-rcar-gen3/conf/machine/m3ulcb-2x4g-kf-xt.conf
```bitbake
#@TYPE: Machine
#@NAME: M3ULCB machine
#@DESCRIPTION: Machine configuration for running xen domain on M3ULCB

require m3ulcb-2x4g-xt.conf

XT_CANONICAL_MACHINE_NAME = "m3ulcb-2x4g-kf"

MACHINEOVERRIDES .= ":kingfisher"
```

## machine/meta-xt-images-rcar-gen3/conf/machine/m3ulcb-2x4g-xt.conf
```bitbake
#@TYPE: Machine
#@NAME: H3ULCB ES3.0 8GB machine
#@DESCRIPTION: Machine configuration for running xen domain on H3ULCB ES3.0 8GB

SOC_FAMILY = "r8a7796"

XT_CANONICAL_MACHINE_NAME = "m3ulcb-2x4g"

require conf/machine/include/rcar.inc

UBOOT_MACHINE = "rcar3_ulcb_defconfig"

MACHINEOVERRIDES .= ":ulcb:rcar:r8a7796-es3"
```
